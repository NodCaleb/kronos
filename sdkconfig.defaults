## sdkconfig.defaults
```kconfig
# Default log level
CONFIG_LOG_DEFAULT_LEVEL_INFO=y

# I2C pin assignments (SSD1306 OLED)
CONFIG_I2C_SDA_GPIO=21
CONFIG_I2C_SCL_GPIO=22

# Shift GDDRAM column window right by 2px to correct panel offset
CONFIG_OFFSETX=2

# TLS / HTTPS
CONFIG_ESP_TLS_USING_MBEDTLS=y
CONFIG_MBEDTLS_CERTIFICATE_BUNDLE_DEFAULT_FULL=y

# Partition table
CONFIG_PARTITION_TABLE_CUSTOM=y
CONFIG_PARTITION_TABLE_CUSTOM_FILENAME="partition-table.csv"

# OTA
CONFIG_APP_UPDATE_VERIFY_AFTER_REBOOT=y
```
